## conf/layer.conf
```bitbake
# We have a conf and classes directory, add to BBPATH
BBPATH .= ":${LAYERDIR}"

# We have recipes-* directories, add to BBFILES
BBFILES += "${LAYERDIR}/recipes-*/*/*.bb \
            ${LAYERDIR}/recipes-*/*/*.bbappend"

BBFILE_COLLECTIONS += "meta-stephendpmurphy"
BBFILE_PATTERN_meta-stephendpmurphy = "^${LAYERDIR}/"
BBFILE_PRIORITY_meta-stephendpmurphy = "6"

LAYERDEPENDS_meta-stephendpmurphy = "core"
LAYERSERIES_COMPAT_meta-stephendpmurphy = "dunfell"
```
